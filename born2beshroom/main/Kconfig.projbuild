## born2beshroom/main/Kconfig.projbuild
```kconfig
menu "SHROOM WiFi configuration"
	config ESP_WIFI_MODE_AP
		bool "Set as WiFi Access Point"
		default n
		help
			Set WiFi to act as independent Access Point

	config ESP_WIFI_SSID
		string "WiFi SSID"
		default "myssid"
		help
			SSID (network name) to create/connect to.

	config ESP_WIFI_PASSWORD
		string "WiFi password"
		default "mypassword"
		help
			WiFi password (WPA/WPA2) to use.

	config ESP_WIFI_CHANNEL
		# visible if ESP_WIFI_MODE_AP
		int "WiFi channel"
		range 1 13
		default 1
		help
			WiFi network channel to use.

	config ESP_MAX_STA_CONN
		# visible if ESP_WIFI_MODE_AP
		int "Maximum STA connections"
		default 4
		help
			Maximum number of the STA connections to this AP.

	config ESP_MAXIMUM_RETRY
		# visible if !ESP_WIFI_MODE_AP
		int "Maximum retry"
		default 10
		help
			Set maximum number of retries to attempt to reconnect to the AP

	config SENSOR_REFRESH
		int "Sensor read delay"
		default 3000
		range 2000 3600000
		help
			Set delay between sensor reads in miliseconds (range 2000 - 3600000)
endmenu
```
